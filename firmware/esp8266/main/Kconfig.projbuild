## firmware/esp8266/main/Kconfig.projbuild
```kconfig
menu "ESP8266 appliance settings"
config APPLIANCE_DEVICE_ID
    string "Device ID (ASCII letters, digits, underscore, hyphen; 1..64)"
    default "device-esp8266"
config APPLIANCE_WIFI_SSID
    string "Wi-Fi SSID"
    default ""
config APPLIANCE_WIFI_PASSWORD
    string "Wi-Fi password"
    default ""
config APPLIANCE_MQTT_URI
    string "TLS broker URI whose hostname matches the CA-signed certificate"
    default "mqtts://localhost:8883"
config APPLIANCE_MQTT_PASSWORD
    string "Unique MQTT device password"
    default ""
config APPLIANCE_OUTPUT_ENABLED
    bool "Enable a confirmed low-voltage demonstration GPIO"
    default n
    help
        Leave disabled until the exact board and output polarity are confirmed.
        This profile never drives mains appliances.
config APPLIANCE_OUTPUT_GPIO
    int "Demonstration GPIO (avoid boot-strap pins and serial pins)"
    range 0 16
    default 4
config APPLIANCE_OUTPUT_ACTIVE_LOW
    bool "Output is active low"
    default n
endmenu
```

## firmware/esp8266/sdkconfig.defaults
```kconfig
CONFIG_ESPTOOLPY_FLASHSIZE_4MB=y
CONFIG_ESPTOOLPY_FLASHMODE_DIO=y
CONFIG_PARTITION_TABLE_CUSTOM=y
CONFIG_PARTITION_TABLE_CUSTOM_FILENAME="partitions.csv"
CONFIG_MQTT_PROTOCOL_311=y
CONFIG_MQTT_TRANSPORT_SSL=y
CONFIG_MQTT_TASK_STACK_SIZE=6144
CONFIG_MQTT_BUFFER_SIZE=1536
CONFIG_ESP_MAIN_TASK_STACK_SIZE=6144
CONFIG_APPLIANCE_OUTPUT_ENABLED=n

CONFIG_MBEDTLS_DYNAMIC_BUFFER=y
CONFIG_MBEDTLS_HAVE_TIME=y
CONFIG_MBEDTLS_HAVE_TIME_DATE=y
```

## firmware/main/Kconfig.projbuild
```kconfig
menu "Appliance settings"
config APPLIANCE_DEVICE_ID
    string "Device ID"
    default "device-0001"
config APPLIANCE_WIFI_SSID
    string "Wi-Fi SSID"
    default ""
config APPLIANCE_WIFI_PASSWORD
    string "Wi-Fi password"
    default ""
config APPLIANCE_BLE_PROVISIONING
    bool "Provision Wi-Fi using the ESP BLE Provisioning app"
    default n
    depends on BT_ENABLED
config APPLIANCE_PROVISION_POP
    string "Unique device proof of possession (at least 16 characters)"
    default ""
    depends on APPLIANCE_BLE_PROVISIONING
    help
        Supplied out of band to the owner. Never log this secret or reuse it
        across devices. An empty value refuses first-time provisioning.
config APPLIANCE_MQTT_URI
    string "TLS broker URI"
    default "mqtts://localhost:8883"
config APPLIANCE_MQTT_PASSWORD
    string "Device MQTT password"
    default ""
config APPLIANCE_OUTPUT_GPIO
    int "Low voltage demonstration output GPIO"
    default 2
config APPLIANCE_OTA_URL
    string "Optional HTTPS application firmware URL"
    default ""
config APPLIANCE_OTA_USE_BROKER_CA
    bool "Use the local broker CA for attended HTTPS OTA"
    default n
endmenu
```

## firmware/sdkconfig.defaults
```kconfig
CONFIG_PARTITION_TABLE_CUSTOM=y
CONFIG_PARTITION_TABLE_CUSTOM_FILENAME="partitions.csv"
CONFIG_BOOTLOADER_APP_ROLLBACK_ENABLE=y
CONFIG_ESPTOOLPY_FLASHSIZE_4MB=y
CONFIG_MBEDTLS_CERTIFICATE_BUNDLE=y
CONFIG_FREERTOS_HZ=1000
```
